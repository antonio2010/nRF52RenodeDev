## Kconfig/Kconfig.modules
```kconfig
menu "nrf (C:\Users\anton\ncs\v1.6.1\nrf)"
osource "C:/Users/anton/ncs/v1.6.1/nrf/Kconfig.nrf"
config ZEPHYR_NRF_MODULE
	bool
	default y
endmenu
menu "mcuboot (C:\Users\anton\ncs\v1.6.1\bootloader\mcuboot)"
osource "$(ZEPHYR_MCUBOOT_KCONFIG)"
config ZEPHYR_MCUBOOT_MODULE
	bool
	default y
endmenu
menu "trusted-firmware-m (C:\Users\anton\ncs\v1.6.1\modules\tee\tfm)"
osource "$(ZEPHYR_TRUSTED_FIRMWARE_M_KCONFIG)"
config ZEPHYR_TRUSTED_FIRMWARE_M_MODULE
	bool
	default y
endmenu
menu "cjson (C:\Users\anton\ncs\v1.6.1\modules\lib\cjson)"
osource "$(ZEPHYR_CJSON_KCONFIG)"
config ZEPHYR_CJSON_MODULE
	bool
	default y
endmenu
menu "pelion-dm (C:\Users\anton\ncs\v1.6.1\modules\lib\pelion-dm)"
osource "C:/Users/anton/ncs/v1.6.1/modules/lib/pelion-dm/zephyr/Kconfig"
config ZEPHYR_PELION_DM_MODULE
	bool
	default y
endmenu
menu "cddl-gen (C:\Users\anton\ncs\v1.6.1\modules\lib\cddl-gen)"
osource "$(ZEPHYR_CDDL_GEN_KCONFIG)"
config ZEPHYR_CDDL_GEN_MODULE
	bool
	default y
endmenu
menu "memfault-firmware-sdk (C:\Users\anton\ncs\v1.6.1\modules\lib\memfault-firmware-sdk)"
osource "C:/Users/anton/ncs/v1.6.1/modules/lib/memfault-firmware-sdk/ports/zephyr/Kconfig"
config ZEPHYR_MEMFAULT_FIRMWARE_SDK_MODULE
	bool
	default y
endmenu
menu "hal_nordic (C:\Users\anton\ncs\v1.6.1\modules\hal\nordic)"
osource "$(ZEPHYR_HAL_NORDIC_KCONFIG)"
config ZEPHYR_HAL_NORDIC_MODULE
	bool
	default y
endmenu
menu "mbedtls (C:\Users\anton\ncs\v1.6.1\modules\crypto\mbedtls)"
osource "$(ZEPHYR_MBEDTLS_KCONFIG)"
config ZEPHYR_MBEDTLS_MODULE
	bool
	default y
endmenu
menu "TraceRecorder (C:\Users\anton\ncs\v1.6.1\modules\debug\TraceRecorder)"
osource "C:/Users/anton/ncs/v1.6.1/modules/debug/TraceRecorder/kernelports/Zephyr/Kconfig"
config ZEPHYR_TRACERECORDER_MODULE
	bool
	default y
endmenu
menu "nrfxlib (C:\Users\anton\ncs\v1.6.1\nrfxlib)"
osource "C:/Users/anton/ncs/v1.6.1/nrfxlib/Kconfig.nrfxlib"
config ZEPHYR_NRFXLIB_MODULE
	bool
	default y
endmenu
menu "connectedhomeip (C:\Users\anton\ncs\v1.6.1\modules\lib\matter)"
osource "C:/Users/anton/ncs/v1.6.1/modules/lib/matter/config/nrfconnect/chip-module/Kconfig"
config ZEPHYR_CONNECTEDHOMEIP_MODULE
	bool
	default y
endmenu
```

## Kconfig/Kconfig.shield.defconfig
```kconfig
osource "C:/Users/anton/ncs/v1.6.1/nrf/boards/shields/*/Kconfig.defconfig"
osource "C:/Users/anton/ncs/v1.6.1/zephyr/boards/shields/*/Kconfig.defconfig"
```

## Kconfig/Kconfig.soc.arch
```kconfig
osource "C:/Users/anton/ncs/v1.6.1/zephyr/soc/$(ARCH)/Kconfig"
osource "C:/Users/anton/ncs/v1.6.1/zephyr/soc/$(ARCH)/*/Kconfig"
```
